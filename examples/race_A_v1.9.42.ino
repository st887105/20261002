// generated by OpenBlock
// TU:bit V2 2026全國競賽路徑規劃器 v1.9.42（程式寫法與課程網站「程式產生器」相同）
// 賽事：物資能源爭霸戰｜機器人 A（全自動）｜起點 (65, 288.5) 車頭 180°｜估算 9.1 秒
// 出發前選邊：手動模式按 SELECT 選邊（第 1 下紅方、再按換藍方，OLED 顯示）→ 按 START 執行自動 → 做完自動回手動；下次自動要再按 SELECT 選邊，只按 SELECT 不會啟動
// ⚠ BNO055：啟動前先把車子擺好方向再按啟動鍵，程式會以「啟動當下的車頭方向」歸零（同積木「BNO 以目前方向設定移動起點」），擺歪了整條路線都會歪
// ⚠ 使用手臂 ATARM：控制板「SERVO POWER SELECT」伺服電源跳帽要往上移，插在 1、2，伺服馬達才有足夠電力
#include <Arduino.h>
#include <TuBitCore.h>
#include <Wire.h>
#include <TuMTC.h>
#include <Preferences.h>
#include <TuIRAlign.h>
#include <Ps3Controller.h>
#include <Adafruit_GFX.h>
#include <Adafruit_SH110X.h>
#include <ATARM.h>
#include <EasyBNO055_ESP.h>

TuBitCore tubit;
TuMTC mtc(tubit);
Adafruit_SH1106G display(128, 64, &Wire);
EasyBNO055_ESP bno;
bool bnoOK = false;   // 開機時有沒有找到 BNO055（沒接好就略過，不讓程式卡住）
extern TuBitCore tubit;
TuMTC& tuirRobot() {
    return mtc;
}
TuIRAlign<TuMTC>& tuirAlign() {
    static TuIRAlign<TuMTC> align(tubit, tuirRobot());
    return align;
}

// ===== 現場微調與校正：數值存在 ESP32 快閃記憶體，斷電不會消失，不用在現場改程式 =====
Preferences tunePrefs;
float TRIM_FWD = 0;   // 前後微調 cm：手動模式按住 START＋L1（前）／L2（後）
float TRIM_PAN = 0;   // 雲台微調 °：手動模式按住 START＋R1（左）／R2（右）
const float TRIM_FWD_STEP = 1;   // 每按一下前後幾公分
const float TRIM_PAN_STEP = 1;   // 每按一下雲台幾度
float FT_GX = 0, FT_GY = 0;   // 現場微調・夾取點：X 往車子右邊＋、Y 往前＋（cm）；手動模式按住 START＋←→／↑↓
float FT_PX = 0, FT_PY = 0;   // 現場微調・放置點：X 往車子右邊＋、Y 往前＋（cm）；手動模式按住 START＋□○／△✕
int FT_ARM = 0;   // 現場微調・手臂角度（°）：夾取、搬運角度一起加減；手動模式按住 START＋按下右搖桿（+1°）／左搖桿（−1°）
const float FT_STEP = 0.5;   // 每按一下移動幾公分
int irT[6] = {25,25,25,25,25,25};   // IR 目標值（前 後 左前 左後 右前 右後），IR 校正模式量測後更新
int irO[6] = {-1, -1, -1, -1, -1, -1};   // 沒有牆（開放空間）時的 IR 讀數；用來判斷「有牆／沒牆」差得夠不夠（黑色隔板反光弱）
bool irSaved = false;   // 是否做過 IR 校正模式（沒做過就略過自動流程的 IR 靠牆校正，避免用錯的目標值把車子轉歪）
double bnoZero = 0;   // BNO 0° 的位置（BNO 校正模式按 A 設定）

// ===== 遙控可調參數（可直接改數字） =====
const int DRIVE_SPEED = 128;   // 移動最高速度（128＝官方範例原值）
const int TURN_SPEED = 128;    // 旋轉速度（128＝官方範例原值）
const int DEADZONE = 8;       // 死區：搖桿小於這個值當作 0，放手時車子不會慢慢飄

// ===== 一鍵自動／手動模式 =====
const int AUTO_AFTER = 2;   // 自動流程做完後：0＝停在自動（AUTO OK）等按手動鍵　1＝重複執行直到按手動鍵　2＝立刻回手動（選邊模式固定為 2：做完自動回手動）
bool sideBlue = false;   // 這一場從哪一方出發：false＝紅方、true＝藍方
bool sideArmed = false;   // 按過 SELECT 選邊才可以按 START 啟動自動；只按 SELECT 不會啟動
bool autoMode = false;   // 目前是否為自動模式
bool autoDone = false;   // 自動流程是否已跑完

// ===== 新版 MTC V3：讓 MTC 讀 BNO055 角度（與兔比積木「BNO 移動」積木相同） =====
struct TuMtcBnoReadyCompat {
 template <typename SensorT>
 static auto read(SensorT &sensor, int) -> decltype(sensor.isReady(), bool()) {
 return sensor.isReady();
 }
 template <typename SensorT>
 static bool read(SensorT &, long) {
 return true;
 }
};
double readTuMtcBnoOrientationZ() {
 return TuMtcBnoReadyCompat::read(bno, 0) ? bno.orientationZ : NAN;
}

// ===== 定點移動：以「設定定點原點」的位置為 (0,0)，當時車頭方向為 Y＋、右邊為 X＋ =====
double posX = 0, posY = 0;   // 目前位置（cm）
double goHeadDeg = 0;   // 相對原點的車頭角度（右轉＋）
bool originSet = false;
double headZero = 0;   // 出發時 BNO 的角度：之後 BNO 轉正都以「出發時的車頭」為 0°，紅方、藍方出發都一樣，不會原地轉半圈
void setOrigin() {   // 把這裡設為原點
  posX = 0; posY = 0; goHeadDeg = 0; originSet = true;
  if (bnoOK) {
    mtc.captureBnoStartFrame();   // BNO：固定場地 X／Y 方向
    headZero = bno.orientationZ;   // 記住出發時的車頭方向（BNO 有地磁時角度是絕對方位，藍方會差 180°）
  }
}
void setPos(double x, double y, double h) {   // 校正後重設目前位置與車頭角度
  posX = x; posY = y; goHeadDeg = h;
}
TuMtcInterruptCallback moveGuard = nullptr;   // 移動中斷檢查：自動流程的長距離移動設成 irGuard（前方 IR 防撞），其他時候不中斷
void goToV(double x, double y, double rot, double vm, double a, double d, double vs, double ve) {   // 同 goTo，vs／ve＝起點／終點速度（ve > 0：不停車直接接下一段）
  // 途中車頭轉 rot 度（右轉＋）；a 加速度、d 減速度（減速慢一點，停得比較準、比較順）
  if (!originSet) setOrigin();
  double dx = x - posX, dy = y - posY;
  if (bnoOK) {
    mtc.moveSCurveBno(dx, dy, rot, vm, a, -d, vs, ve, moveGuard);   // BNO 精準移動：X／Y 依原點方向固定，陀螺儀邊走邊修正航向
  } else {
    double h = goHeadDeg * PI / 180.0;   // 換算成目前車身方向
    mtc.moveSCurve(dx * cos(h) - dy * sin(h), dx * sin(h) + dy * cos(h), rot, vm, a, -d, vs, ve, moveGuard);   // MTC V3：旋轉＋＝右轉
  }
  posX = x; posY = y; goHeadDeg += rot;
}
void goTo(double x, double y, double rot, double vm, double a, double d) {   // 前往定點 (x, y)，途中車頭轉 rot 度（右轉＋）；a 加速度、d 減速度；到點停車
  goToV(x, y, rot, vm, a, d, 0, 0);
}
void goTo(double x, double y, double rot, double vm, double a) {   // 減速度和加速度相同
  goTo(x, y, rot, vm, a, a);
}
void goDist(double bx, double by, double vm, double a) {   // 依目前車頭方向移動（右＋、前＋），並更新位置
  mtc.moveSCurve(bx, by, 0, vm, a, -a, 0, 0);
  double h = goHeadDeg * PI / 180.0;
  posX += bx * cos(h) + by * sin(h);
  posY += -bx * sin(h) + by * cos(h);
}

// ===== IR 限距靠牆：每次只走 0.5 cm、最多走 maxCm，讀數跨過「離牆目標值」就停；走到上限還沒跨過就不相信 IR（黑色隔板反光弱，不會一直推牆） =====
bool irGuard() {   // IR 防撞：前方 IR 連續 2 次比「離牆 10 cm」目標值更靠近就中斷移動（沒做 IR 校正或黑色隔板對比不足就不中斷）
  static int hit = 0;
  if (!irSaved || irO[0] < 0 || !irContrastOk(0)) return false;
  int sgn = irT[0] > irO[0] ? 1 : -1;   // 靠近牆讀數變大（1）或變小（-1）
  hit = (irRead(0) - irT[0]) * sgn > 0 ? hit + 1 : 0;
  return hit >= 2;
}
int irAvg(int a, int b) {   // 一顆或兩顆 IR 的平均讀數（b < 0 只用一顆）
  long v = 0;
  for (int n = 0; n < 4; n++) { v += irRead(a) + (b >= 0 ? irRead(b) : 0); delay(3); }
  return v / (b >= 0 ? 8 : 4);
}
bool irStepTo(int a, int b, double bx, double by, double maxCm) {   // (bx, by)：車身座標中「朝牆」的方向；成功＝真的停在離牆目標距離
  if (!irSaved || irO[a] < 0 || !irContrastOk(a) || (b >= 0 && !irContrastOk(b))) return false;   // 沒量過「沒有牆」就不知道讀數往哪邊變，不動
  int t = b >= 0 ? (irT[a] + irT[b]) / 2 : irT[a];
  int sgn = irT[a] > irO[a] ? 1 : -1;   // 靠近牆時讀數變大（1）或變小（-1）
  int e0 = (t - irAvg(a, b)) * sgn;   // > 0：離牆太遠，要靠近
  if (e0 == 0) return true;
  double dir = e0 > 0 ? 1 : -1, step = maxCm > 6 ? 2 : 0.5, moved = 0;   // 找得遠（出發校正）先 2 cm 一步，跨過目標值再 0.5 cm 一步退回來
  while (fabs(moved + dir * step) <= maxCm) {
    goDist(bx * dir * step, by * dir * step, 250, 400);
    moved += dir * step;
    int e = (t - irAvg(a, b)) * sgn;
    if (e == 0) return true;
    if ((e > 0) != (e0 > 0)) {   // 跨過目標值
      if (step <= 0.5) return true;   // 0.5 cm 精度：到了
      step = 0.5; dir = -dir; e0 = e;   // 2 cm 走過頭：改 0.5 cm 往回找
    }
  }
  goDist(-bx * moved, -by * moved, 250, 400);   // 走到上限還沒到：退回原位，照座標繼續
  return false;
}
void irFix(double nx, double ny, double cx, double cy) {   // IR 校正成功：只修正「垂直牆面」那個方向的座標，另一個方向照舊
  double d = (cx - posX) * nx + (cy - posY) * ny;
  posX += d * nx;
  posY += d * ny;
}

// ===== 自動移動速度：規劃好路線後，改這個數字就能讓所有自動移動一起變快或變慢 =====
const int AUTO_SPEED = 100;   // 100＝原規劃速度；80＝慢一點、停得比較準；120＝快一點（範圍 10～200）
double autoV(double v) {   // 依 AUTO_SPEED 換算 MTC 移動的最高速度與加減速度
  return v * AUTO_SPEED / 100.0;
}

bool bnoFound() {   // 先確認 I2C 位址 0x28 有 BNO055；bno.start() 找不到感測器會一直等，整支程式會卡住
  Wire.begin();
  for (int i = 0; i < 30; i++) {   // BNO055 上電約 0.65 秒後才回應，最多重試 3 秒
    Wire.beginTransmission(0x28);
    if (Wire.endTransmission() == 0) return true;
    delay(100);
  }
  return false;
}

String i2cList() {   // 列出 I2C 上有回應的位址：0x3C＝OLED、0x28＝BNO055；只有 0x29 代表 BNO 的 ADR 腳接到高電位（要接 GND 改回 0x28）
  String s = "";
  for (uint8_t a = 1; a < 127; a++) {
    Wire.beginTransmission(a);
    if (Wire.endTransmission() == 0) { char b[6]; sprintf(b, "0x%02X ", a); s += b; }
  }
  return s.length() ? s : String("none");
}

void tuneLoad() {   // 開機讀取微調值
  tunePrefs.begin("tubit", true);
  TRIM_FWD = tunePrefs.getFloat("fwd", 0);
  TRIM_PAN = tunePrefs.getFloat("pan", 0);
  FT_GX = tunePrefs.getFloat("gx", 0);
  FT_GY = tunePrefs.getFloat("gy", 0);
  FT_PX = tunePrefs.getFloat("px", 0);
  FT_PY = tunePrefs.getFloat("py", 0);
  FT_ARM = tunePrefs.getInt("arm", 0);
  for (int i = 0; i < 6; i++) irT[i] = tunePrefs.getInt((String("ir") + i).c_str(), irT[i]);
  for (int i = 0; i < 6; i++) irO[i] = tunePrefs.getInt((String("io") + i).c_str(), -1);
  irSaved = tunePrefs.getBool("irok", false);
  bnoZero = tunePrefs.getDouble("bz", 0);
  tunePrefs.end();
}

void tuneSave() {   // 儲存微調值
  tunePrefs.begin("tubit", false);
  tunePrefs.putFloat("fwd", TRIM_FWD);
  tunePrefs.putFloat("pan", TRIM_PAN);
  tunePrefs.putFloat("gx", FT_GX);
  tunePrefs.putFloat("gy", FT_GY);
  tunePrefs.putFloat("px", FT_PX);
  tunePrefs.putFloat("py", FT_PY);
  tunePrefs.putInt("arm", FT_ARM);
  for (int i = 0; i < 6; i++) tunePrefs.putInt((String("ir") + i).c_str(), irT[i]);
  for (int i = 0; i < 6; i++) tunePrefs.putInt((String("io") + i).c_str(), irO[i]);
  tunePrefs.putBool("irok", irSaved);
  tunePrefs.putDouble("bz", bnoZero);
  tunePrefs.end();
}

void tuneShow(const char *msg) {   // OLED／序列埠顯示目前微調值
  Serial.printf("TRIM FWD %.1f cm  PAN %.1f deg  %s\n", TRIM_FWD, TRIM_PAN, msg);
  display.clearDisplay();
  display.setFont();
  display.setTextSize(1);
  display.setTextColor(SH110X_WHITE);
  display.setCursor(0, 0);
  display.println("TRIM  START+L/R");
  display.print("FWD ");
  display.print(TRIM_FWD, 1);
  display.println(" cm");
  display.print("PAN ");
  display.print(TRIM_PAN, 1);
  display.println(" deg");
  display.println("GRAB  X" + String(FT_GX, 1) + " Y" + String(FT_GY, 1));
  display.println("PLACE X" + String(FT_PX, 1) + " Y" + String(FT_PY, 1));
  display.println("ARM   " + String(55 + FT_ARM) + " (" + String(FT_ARM >= 0 ? "+" : "") + String(FT_ARM) + ") deg");
  Serial.printf("ARM UP %d deg (%+d)\n", 55 + FT_ARM, FT_ARM);
  Serial.printf("GRAB X %.1f Y %.1f  PLACE X %.1f Y %.1f\n", FT_GX, FT_GY, FT_PX, FT_PY);
  display.println(msg);
  display.display();
}

void armApply(bool show) {   // 套用手臂角度微調：升降範圍跟著平移（手動模式也不會超過）；show＝手臂移到搬運高度給你看
  ATARM_SetLiftRange(max(0, 2 + FT_ARM), 55 + FT_ARM);
  if (show) ATARM_LiftSet(55 + FT_ARM, 0);
}

void trimBefore() {   // 到夾取／放置點：先套用微調
  if (TRIM_FWD != 0) goDist(0, TRIM_FWD, 300, 400);   // 前後微調
  if (TRIM_PAN != 0) ATARM_PanAdd(TRIM_PAN);   // 雲台微調
}

void trimAfter() {   // 夾好／放好後復原，後面的路線不受影響
  if (TRIM_PAN != 0) ATARM_PanAdd(-TRIM_PAN);
  if (TRIM_FWD != 0) goDist(0, -TRIM_FWD, 300, 400);
}

bool startHeld = false, startCombo = false;
bool startClick() {   // START 放開才算「按一下」；按住 START 時按過 L1／L2／R1／R2／SELECT 是微調，不會啟動自動
  bool s = Ps3.isConnected() && Ps3.data.button.start;
  if (s) {
    startHeld = true;
    if (Ps3.data.button.l1 || Ps3.data.button.l2 || Ps3.data.button.r1 || Ps3.data.button.r2 || Ps3.data.button.select || Ps3.data.button.up || Ps3.data.button.down || Ps3.data.button.left || Ps3.data.button.right || Ps3.data.button.square || Ps3.data.button.circle || Ps3.data.button.triangle || Ps3.data.button.cross || Ps3.data.button.l3 || Ps3.data.button.r3) startCombo = true;
    return false;
  }
  if (startHeld) {
    startHeld = false;
    bool go = !startCombo;
    startCombo = false;
    return go;
  }
  return false;
}

bool pL1 = false, pL2 = false, pR1 = false, pR2 = false, pSel = false;
void tuneKeys() {   // 手動模式：按住 START＋L1／L2 前後微調、R1／R2 雲台微調、SELECT 歸零
  if (!Ps3.isConnected()) return;
  bool st = Ps3.data.button.start;
  bool l1 = st && Ps3.data.button.l1, l2 = st && Ps3.data.button.l2, r1 = st && Ps3.data.button.r1, r2 = st && Ps3.data.button.r2, sl = st && Ps3.data.button.select;
  bool changed = false;
  int armWas = FT_ARM;
  if (l1 && !pL1) { TRIM_FWD += TRIM_FWD_STEP; changed = true; }
  if (l2 && !pL2) { TRIM_FWD -= TRIM_FWD_STEP; changed = true; }
  if (r1 && !pR1) { TRIM_PAN += TRIM_PAN_STEP; changed = true; }
  if (r2 && !pR2) { TRIM_PAN -= TRIM_PAN_STEP; changed = true; }
  if (sl && !pSel) { TRIM_FWD = 0; TRIM_PAN = 0; FT_GX = 0; FT_GY = 0; FT_PX = 0; FT_PY = 0; FT_ARM = 0; changed = true; }
  pL1 = l1; pL2 = l2; pR1 = r1; pR2 = r2; pSel = sl;
  static bool pK[8] = {false, false, false, false, false, false, false, false};   // ← → ↑ ↓ □ ○ △ ✕ 上一次是否按著
  bool k[8] = {st && Ps3.data.button.left, st && Ps3.data.button.right, st && Ps3.data.button.up, st && Ps3.data.button.down,
               st && Ps3.data.button.square, st && Ps3.data.button.circle, st && Ps3.data.button.triangle, st && Ps3.data.button.cross};
  float *v[8] = {&FT_GX, &FT_GX, &FT_GY, &FT_GY, &FT_PX, &FT_PX, &FT_PY, &FT_PY};
  const float d[8] = {-FT_STEP, FT_STEP, FT_STEP, -FT_STEP, -FT_STEP, FT_STEP, FT_STEP, -FT_STEP};   // 夾取：← 左 → 右 ↑ 前 ↓ 後；放置：□ 左 ○ 右 △ 前 ✕ 後
  for (int i = 0; i < 8; i++) { if (k[i] && !pK[i]) { *v[i] += d[i]; changed = true; } pK[i] = k[i]; }
  static bool pL3 = false, pR3 = false;   // 手臂角度：按住 START＋按下右搖桿 +1°、左搖桿 −1°（最多 ±20°）
  bool l3 = st && Ps3.data.button.l3, r3 = st && Ps3.data.button.r3;
  if (r3 && !pR3 && FT_ARM < 20) FT_ARM++;
  if (l3 && !pL3 && FT_ARM > -20) FT_ARM--;
  pL3 = l3; pR3 = r3;
  if (FT_ARM != armWas) { armApply(true); changed = true; }   // 手臂馬上移到新的搬運高度，量量看夠不夠高
  if (changed) {
    tuneSave();
    tuneShow("SAVED");
    Ps3.setRumble(60, 120);
  }
}

int irRead(int i) {   // 讀第 i 顆 IR 濾波值（0 前 1 後 2 左前 3 左後 4 右前 5 右後）
  tuirAlign().readAllIR_();
  switch (i) {
    case 0: return tuirAlign().getFilteredUP();
    case 1: return tuirAlign().getFilteredBK();
    case 2: return tuirAlign().getFilteredLU();
    case 3: return tuirAlign().getFilteredLB();
    case 4: return tuirAlign().getFilteredRU();
  }
  return tuirAlign().getFilteredRB();
}

const int IR_SEE_PCT = 35;   // IR 讀數和「離牆 10 cm 目標值」差在 35% 以內，才算看到牆（沒有隔板就不靠牆校正，避免原地亂轉）
bool irContrastOk(int i) {   // 有牆和沒牆的讀數差夠大，這顆 IR 才可靠（黑色隔板反光弱、差太小就不用）
  if (irO[i] < 0) return true;   // 沒量過「沒有牆」：照舊只看目標值
  return abs(irT[i] - irO[i]) >= max(5, abs(irT[i]) * IR_SEE_PCT / 100);
}
bool irNear(int i) {   // 第 i 顆 IR 是否看到牆（接近校正距離）；夾取物太小，通常只有一顆看得到，兩顆側邊同時看到才是牆
  if (!irContrastOk(i)) return false;   // 有牆、沒牆分不出來：不用這顆 IR，照座標走
  int v = 0;
  for (int n = 0; n < 5; n++) { v += irRead(i); delay(4); }
  v /= 5;
  int t = irT[i];
  if (irO[i] >= 0) return abs(v - t) * 2 < abs(t - irO[i]);   // 讀數比較接近「有牆」而不是「沒牆」
  return abs(v - t) <= max(3, abs(t) * IR_SEE_PCT / 100);
}

void irCalMode() {   // IR 校正模式：把車子某一面放在離牆 10 cm，按 A 記錄；依序 前→後→左→右→沒有牆，按 B 跳過
  const char *side[5] = {"FRONT 33", "BACK 32", "LEFT 35/34", "RIGHT 39/36", "OPEN: no wall"};
  const int first[5] = {0, 1, 2, 4, 0}, cnt[5] = {1, 1, 2, 2, 6};
  int s = 0;
  const char *nm6[6] = {"F ", "B ", "LF ", "LB ", "RF ", "RB "};
  while (tubit.readButton(Button_A)) delay(10);   // 等放開 A
  while (s < 5) {
    display.clearDisplay();
    display.setFont();
    display.setTextSize(1);
    display.setTextColor(SH110X_WHITE);
    display.setCursor(0, 0);
    display.println(s < 4 ? "IR CAL: 10cm to wall" : "IR: 40cm+ from walls");
    display.print("SIDE ");
    display.println(side[s]);
    const char *nm[6] = {"F33 ", "B32 ", "LF35", "LB34", "RF39", "RB36"};
    for (int i = 0; i < 6; i++) {
      display.print(nm[i]);
      display.print(" ");
      display.print(irRead(i));
      display.print(" T");
      display.println(irT[i]);
    }
    display.display();
    if (tubit.readButton(Button_A)) {   // 記錄：取 20 次平均
      for (int k = 0; k < cnt[s]; k++) {
        long sum = 0;
        for (int n = 0; n < 20; n++) { sum += irRead(first[s] + k); delay(10); }
        if (s < 4) irT[first[s] + k] = sum / 20;
        else irO[first[s] + k] = sum / 20;   // 第 5 步：四周 40 cm 內沒有牆的讀數
      }
      Serial.printf("IR %s saved\n", side[s]);
      s++;
      while (tubit.readButton(Button_A)) delay(10);
    }
    if (tubit.readButton(Button_B)) {   // 跳過這一面
      s++;
      while (tubit.readButton(Button_B)) delay(10);
    }
    delay(80);
  }
  irSaved = true;   // 做過 IR 校正，自動流程才會用 IR 靠牆校正
  tuneSave();
  tuirAlign().setTargets(irT[0], irT[1], irT[2], irT[3], irT[4], irT[5]);
  Serial.printf("setTargets(%d,%d,%d,%d,%d,%d)\n", irT[0], irT[1], irT[2], irT[3], irT[4], irT[5]);
  display.clearDisplay();
  display.setCursor(0, 0);
  display.println("IR CONTRAST");
  for (int i = 0; i < 6; i++) {   // 每顆 IR：有牆／沒牆的讀數差夠不夠（LOW＝黑色隔板反光太弱，自動流程不會用這顆）
    display.print(nm6[i]);
    display.print(irT[i]);
    display.print("/");
    display.print(irO[i]);
    display.println(irO[i] < 0 ? " ?" : (irContrastOk(i) ? " OK" : " LOW"));
  }
  display.display();
  delay(4000);
  tuneShow("IR SAVED");
  delay(1500);
}

void bnoCalMode() {   // BNO 校正模式：靜置看漂移；A＝把目前方向設為 0°，B＝離開
  while (tubit.readButton(Button_B)) delay(10);
  double z0 = bno.orientationZ;
  unsigned long t0 = millis();
  while (true) {
    double sec = (millis() - t0) / 1000.0;
    double drift = sec > 1 ? (bno.orientationZ - z0) / sec * 60.0 : 0;   // 每分鐘漂移幾度
    display.clearDisplay();
    display.setFont();
    display.setTextSize(1);
    display.setTextColor(SH110X_WHITE);
    display.setCursor(0, 0);
    display.println(bnoOK ? "BNO CAL (keep still)" : "NO BNO055 (I2C 0x28)");
    display.print("HEAD ");
    display.println(bno.orientationZ - bnoZero, 1);
    display.print("DRIFT ");
    display.print(drift, 2);
    display.println(" deg/min");
    display.println(sec < 10 ? "measuring..." : (fabs(drift) < 0.5 ? "STABLE OK" : "MOVING? wait"));
    display.println("A=ZERO  B=EXIT");
    display.display();
    if (tubit.readButton(Button_A)) {
      bnoZero = bno.orientationZ;
      tuneSave();
      z0 = bno.orientationZ;
      t0 = millis();
      while (tubit.readButton(Button_A)) delay(10);
    }
    if (tubit.readButton(Button_B)) break;
    delay(100);
  }
  while (tubit.readButton(Button_B)) delay(10);
}

int stickVal(int v) {   // 套用死區
  return abs(v) < DEADZONE ? 0 : v;
}

void remoteControl() {   // 手動遙控（PS3）
  if (!Ps3.isConnected()) {
    tubit.stopAllMotors();   // 手把斷線就停車
    return;
  }
  int x = 0, y = 0, r = 0;   // 車子移動量：x 左右平移、y 前後、r 旋轉
  // 搖桿：左搖桿上下＝前進／後退、左右＝平移；右搖桿左右＝原地旋轉
  x += stickVal(Ps3.data.analog.stick.lx) * DRIVE_SPEED / 128;
  y -= stickVal(Ps3.data.analog.stick.ly) * DRIVE_SPEED / 128;   // 往上推 ly 是負值
  r += stickVal(Ps3.data.analog.stick.rx) * TURN_SPEED / 128;
  mtc.driveVectorOpen(constrain(x, -255, 255), constrain(y, -255, 255), constrain(r, -255, 255));
  if (!Ps3.data.button.start && Ps3.data.button.up) ATARM_LiftAdd(0.3);   // ↑ → 手臂升降累加
  if (!Ps3.data.button.start && Ps3.data.button.down) ATARM_LiftAdd(-0.3);   // ↓ → 手臂升降累加
  if (!Ps3.data.button.start && Ps3.data.button.left) ATARM_PanAdd(0.1);   // ← → 手臂旋轉累加
  if (!Ps3.data.button.start && Ps3.data.button.right) ATARM_PanAdd(-0.1);   // → → 手臂旋轉累加
  if (!Ps3.data.button.start && Ps3.data.button.triangle) ATARM_ClawCtrl(false,0.5);   // △ → 夾爪張開
  if (!Ps3.data.button.start && Ps3.data.button.circle) ATARM_ClawCtrl(true,0.5);   // ○ → 夾爪夾緊
}

bool autoKey() {   // 切到自動模式的按鍵
  return startClick();
}

bool manualKey() {   // 切回手動模式的按鍵
  return Ps3.isConnected() && Ps3.data.button.select;
}

bool abortAuto() {   // 自動途中按手動鍵就中止（每個動作做完檢查一次）
  if (manualKey()) {
    autoMode = false;
    tubit.stopAllMotors();
    return true;
  }
  return false;
}

bool selHeld = false, selCombo = false;
bool selectClick() {   // SELECT 放開才算「按一下」；按住 START 時的 SELECT 是微調歸零，不算選邊
  bool s = Ps3.isConnected() && Ps3.data.button.select;
  if (s) {
    selHeld = true;
    if (Ps3.data.button.start) selCombo = true;
    return false;
  }
  if (selHeld) {
    selHeld = false;
    bool go = !selCombo;
    selCombo = false;
    return go;
  }
  return false;
}

void sideReset() {   // 自動結束（做完或中止）：要再選一次邊才能再自動；按著的 SELECT 放開時不算選邊
  sideArmed = false;
  selHeld = Ps3.isConnected() && Ps3.data.button.select;
  selCombo = selHeld;
}

void showSide() {   // 顯示選到的出發方
  Serial.println(sideArmed ? (sideBlue ? "SIDE BLUE  START=GO" : "SIDE RED  START=GO") : "PRESS SELECT FIRST (RED/BLUE)");
  display.clearDisplay();
  display.setFont();
  display.setTextColor(SH110X_WHITE);
  display.setTextSize(2);
  display.setCursor(0, 0);
  display.println(sideArmed ? (sideBlue ? "BLUE" : "RED") : "SIDE?");
  display.setTextSize(1);
  display.println(sideArmed ? (sideBlue ? "X235 Y11.5 UP" : "X65 Y288.5 DOWN") : "PRESS SELECT FIRST");
  display.println(sideArmed ? "START = GO AUTO" : "");
  display.println("SELECT = RED / BLUE");
  display.display();
  if (sideArmed) {   // 震動提示：紅方 1 下、藍方 2 下
    Ps3.setRumble(100, 150);
    if (sideBlue) {
      delay(300);
      Ps3.setRumble(100, 150);
    }
  }
}

void showMode() {   // OLED 顯示目前模式
  display.clearDisplay();
  display.setFont();
  display.setTextSize(2);
  display.setTextColor(SH110X_WHITE);
  display.setCursor(0, 20);
  display.print(autoMode ? (autoDone ? "AUTO OK" : "AUTO") : "MANUAL");
  display.display();
}

void runAuto() {   // 一鍵自動流程
  if (abortAuto()) return;
  // 起點設為定點原點（BNO 精準定點：之後每個路徑點都用座標前往）
  setOrigin();
  if (abortAuto()) return;
  // 出發前-1 手臂抬升到 55°
  ATARM_LiftSet(55 + FT_ARM,0);   // 手臂升降
  if (abortAuto()) return;
  // 出發前-2 夾爪張開
  ATARM_ClawCtrl(false,0);   // 夾爪張開
  if (abortAuto()) return;
  // ===== P1 前往 (65, 210) 車頭 180° =====
  mtc.setHeadingSettle(8.0, 0, 30);   // 不停車：到點不等車頭轉正，直接接下一段
  moveGuard = irGuard;   // 長距離快速移動：前方 IR 看到牆太近就停，避免撞牆
  goToV(0, 78.5, 0, autoV(2000), autoV(4500), autoV(3000), autoV(0), autoV(800));   // 不停車接下一段，定點座標 (0, 78.5)
  moveGuard = nullptr;
  if (abortAuto()) return;
  // ===== P2 前往 (78, 187) 車頭 180° =====
  mtc.setHeadingSettle(1.0, 80, 1000);   // 到點：車頭轉正到 1° 內
  goToV((-13) + (-3) + FT_GX, 101.5 + FT_GY, 0, autoV(1000), autoV(2000), autoV(1200), autoV(800), autoV(0));   // 接續上一段，定點座標 (-13, 101.5)
  if (abortAuto()) return;
  // P2-1 手臂下降到 2°
  trimBefore();   // 套用現場微調（前後、雲台）：手臂還抬著時先移到位，再下降
  ATARM_LiftSet(2 + FT_ARM,0);   // 手臂升降
  if (abortAuto()) return;
  // P2-2 等待 0.4 秒
  delay(0.4 * 1000);
  if (abortAuto()) return;
  // P2-3 夾爪夾緊
  ATARM_ClawCtrl(true,0);   // 夾爪夾緊
  if (abortAuto()) return;
  // P2-4 等待 0.3 秒
  delay(0.3 * 1000);
  if (abortAuto()) return;
  // P2-5 手臂抬升到 55°
  ATARM_LiftSet(55 + FT_ARM,0);   // 手臂升降
  trimAfter();   // 夾著齒輪抬起後再復原微調
  if (abortAuto()) return;
  // P2-6 等待 0.2 秒
  delay(0.2 * 1000);
  if (abortAuto()) return;
  // ===== P3 前往 (78, 187) 車頭 90° =====
  mtc.setHeadingSettle(3.0, 30, 300);   // 長距離：車頭差 3° 內就走下一段（省時）
  goTo((-13), 101.5, 90, autoV(1500), autoV(3500), autoV(2200));   // 定點座標 (-13, 101.5)，車頭右轉 90°
  if (abortAuto()) return;
  // ===== P4 前往 (28.4, 165) 車頭 90° =====
  mtc.setHeadingSettle(3.0, 30, 300);   // 長距離：車頭差 3° 內就走下一段（省時）
  moveGuard = irGuard;   // 長距離快速移動：前方 IR 看到牆太近就停，避免撞牆
  goTo(36.6 + FT_PY, 123.5, 0, autoV(2000), autoV(4500), autoV(3000));   // 定點座標 (36.6, 123.5)
  moveGuard = nullptr;
  if (abortAuto()) return;
  // ===== P5 前往 (27.5, 107) 車頭 90° =====
  mtc.setHeadingSettle(1.0, 80, 1000);   // 到點：車頭轉正到 1° 內
  goTo(37.5 + FT_PY, 181.5 + 10 - FT_PX, 0, autoV(1500), autoV(3500), autoV(2200));   // 定點座標 (37.5, 181.5)
  if (abortAuto()) return;
  // ===== P6 前往 (27, 107) 車頭 90° =====
  mtc.setHeadingSettle(1.0, 80, 1000);   // 到點：車頭轉正到 1° 內
  goTo(38 + FT_PY, 181.5 + 10 - FT_PX, 0, autoV(800), autoV(1500), autoV(900));   // 定點座標 (38, 181.5)
  if (abortAuto()) return;
  // P6-1 夾爪張開
  ATARM_ClawCtrl(false,0);   // 夾爪張開
  if (abortAuto()) return;
  // P6-2 等待 0.3 秒
  delay(0.3 * 1000);
  if (abortAuto()) return;
}

void setup() {
  tubit.init();
  tuneLoad();   // 讀取現場微調與 IR 校正值（存在快閃記憶體）
  display.begin(0x3C, true);
  bnoOK = bnoFound();
  if (bnoOK) bno.start();   // 找到 BNO055 才啟動
  else {   // 找不到 BNO055：序列埠與 OLED 列出 I2C 上找到的位址，判斷是沒接好還是位址不對
    String found = i2cList();
    Serial.println("BNO055 not found (I2C 0x28): check SDA/SCL/VIN/GND");
    Serial.println("I2C devices: " + found + (found.indexOf("0x29") >= 0 ? " -> BNO at 0x29: connect ADR pin to GND" : ""));
    display.clearDisplay();
    display.setFont();
    display.setTextSize(1);
    display.setTextColor(SH110X_WHITE);
    display.setCursor(0, 0);
    display.println("NO BNO055 at 0x28");
    display.println("I2C found:");
    display.println(found);
    display.println(found.indexOf("0x29") >= 0 ? "ADR pin -> GND" : "check VIN GND SDA SCL");
    display.display();
    delay(3000);
  }
  if (bnoOK) {   // 新版 MTC V3：定點移動用 BNO 修正航向
    unsigned long tuMtcBnoWaitStart = millis();
    while (!TuMtcBnoReadyCompat::read(bno, 0) && millis() - tuMtcBnoWaitStart < 5000UL) delay(20);
    mtc.setYawReader(readTuMtcBnoOrientationZ);
    mtc.setYawDirection(1);
    mtc.setHeadingPid(3.0, 0.0, 0.03, 120.0, 60.0);
    mtc.setHeadingSettle(1.0, 100, 1500);
  }
  Ps3.begin("10:00:00:02:22:35");   // 改成自己手把記住的 MAC
  tuirAlign();   // 初始化 IR 靠牆校正模式 麥克納姆輪 MTC
  tuirAlign().setPins(33,32,35,34,39,36);   // 前 後 左前 左後 右前 右後
  tuirAlign().setTargets(irT[0],irT[1],irT[2],irT[3],irT[4],irT[5]);   // 目標值：IR 校正模式量到的數值（沒量過就用預設）
  ATARM_INIT(S0,S7,S6);   // 旋轉, 升降, 夾爪
  ATARM_SetClawRange(80,150);   // 張開, 夾緊
  armApply(false);   // 手臂升降範圍 2～55°（含現場手臂角度微調）
  ATARM_SetPanRange(55,125);   // 旋轉範圍
  if (tubit.readButton(Button_A)) irCalMode();   // 開機時按住控制板 A：IR 校正模式
  if (tubit.readButton(Button_B)) bnoCalMode();   // 開機時按住控制板 B：BNO 校正模式
  tuneShow("READY");   // 開機顯示目前微調值
  delay(800);

  Serial.println("PLACE A at (65, 288.5) head 180 deg");   // 規劃器的出發點，車子一定要擺在這裡
  display.clearDisplay();
  display.setFont();
  display.setTextSize(1);
  display.setTextColor(SH110X_WHITE);
  display.setCursor(0, 0);
  display.println("PLACE CAR AT");
  display.println("RED  X65 Y288.5 DOWN");
  display.println("BLUE X235 Y11.5 UP");
  display.println("SELECT=SIDE START=GO");
  display.println(bnoOK ? "BNO OK" : "BNO NONE!");
  display.println(irSaved ? "IR CAL OK" : "IR NOT CAL! hold A");
  display.display();
  delay(2500);
  showMode();
}

void loop() {
  if (!autoMode) tuneKeys();   // 手動模式：按住 START＋L1／L2／R1／R2 現場微調
  if (!autoMode && selectClick()) {   // 按 SELECT 選邊：第 1 下＝紅方，再按一下換藍方／紅方（只按 SELECT 不會啟動）
    sideBlue = sideArmed ? !sideBlue : false;
    sideArmed = true;
    showSide();
  }
  if (!autoMode && autoKey()) {   // 選好邊再按 START 才進自動
    if (!sideArmed) {
      showSide();   // 還沒選邊：提示先按 SELECT
    } else {
      autoMode = true;
      autoDone = false;
      Ps3.setRumble(100, 300);
      showMode();
    }
  }
  if (autoMode && manualKey()) {   // 一鍵切回手動
    autoMode = false;
    tubit.stopAllMotors();
    sideReset();
    Ps3.setRumble(100, 300);
    showMode();
  }
  if (autoMode) {
    if (!autoDone) {
      runAuto();   // 紅藍對稱：兩邊用同一條流程（以出發點為原點）
      if (!autoMode) {   // 途中按了手動鍵
        sideReset();
        showMode();
        return;
      }
      if (AUTO_AFTER != 1) {   // 1＝重複執行：不標記完成，下一圈再跑一次
        autoDone = true;
        tubit.stopAllMotors();
        if (AUTO_AFTER == 2) autoMode = false;
        sideReset();   // 做完自動回手動；下次自動要再按 SELECT 選邊
        showMode();
      }
    }
    return;   // 自動模式中不接受遙控，按手動鍵才切回
  }
  remoteControl();   // 手動遙控：移動＋按鍵對應
}
